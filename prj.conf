## prj.conf
```kconfig
CONFIG_BT=y
CONFIG_BT_BROADCASTER=y
CONFIG_BT_OBSERVER=y
CONFIG_BT_EXT_ADV=y
CONFIG_BT_CTLR_PHY_2M=y
CONFIG_BT_DEVICE_NAME="CAM extended"

CONFIG_BT_DEBUG_LOG=y

CONFIG_BT_CTLR_ADV_DATA_LEN_MAX=1650

CONFIG_BT_SETTINGS=y
CONFIG_FLASH=y
CONFIG_FLASH_PAGE_LAYOUT=y
CONFIG_FLASH_MAP=y
CONFIG_NVS=y
CONFIG_SETTINGS=y
CONFIG_MPU_ALLOW_FLASH_WRITE=y  # to write the MAC to the network core

# Enable the UART driver
CONFIG_UART_ASYNC_API=y
CONFIG_NRFX_UARTE0=y
CONFIG_SERIAL=y
CONFIG_CONSOLE=y
CONFIG_UART_CONSOLE=y
CONFIG_HEAP_MEM_POOL_SIZE=16384

# Increase Advertising PDU buffers to number of advertising sets times the
# number of chain PDUs per advertising set when using Zephyr Bluetooth LE
# Controller
# CONFIG_BT_CTLR_ADVANCED_FEATURES=y
# CONFIG_BT_CTLR_ADV_DATA_BUF_MAX=2

CONFIG_SYSTEM_WORKQUEUE_STACK_SIZE=4096

# Extended scanning
CONFIG_BT_EXT_SCAN_BUF_SIZE=1650

# Zephyr Bluetooth LE Controller needs 16 event buffers to generate Extended
# Advertising Report for receiving the complete 1650 bytes of data
CONFIG_BT_BUF_EVT_RX_COUNT=255

CONFIG_BT_SCAN=y
CONFIG_BT_SCAN_FILTER_ENABLE=y
CONFIG_BT_SCAN_UUID_CNT=1

# CONFIG_BT_USER_PHY_UPDATE=y
```

## src/broadcaster_multiple.c
```c
/*
 * Copyright (c) 2022 Nordic Semiconductor ASA
 *
 * SPDX-License-Identifier: Apache-2.0
 */

// #include <zephyr/sys/printk.h>
#include <zephyr/bluetooth/bluetooth.h>

#include <zephyr/bluetooth/hci.h>
#include <zephyr/bluetooth/hci_vs.h>
#include <zephyr/settings/settings.h>
#include "cam.h"

#include <zephyr/drivers/uart.h>

#define UART_WAIT_FOR_BUF_DELAY K_MSEC(50)		// default 50 ms
#define UART_RX_TIMEOUT 50

static const struct device *uart = DEVICE_DT_GET(DT_NODELABEL(uart0));

static struct k_work_delayable uart_work;

struct uart_data_t {
	void *fifo_reserved;
	uint8_t  data[UART_BUF_SIZE];
	uint16_t len;
};

static K_FIFO_DEFINE(fifo_uart_tx_data);
static K_FIFO_DEFINE(fifo_uart_rx_data);

uint8_t  mac[BT_ADDR_SIZE] = { 0x46, 0xb3, 0x1d, 0xc2, 0x45, 0xf2 };

static const struct bt_data ad[] = {
	BT_DATA(BT_DATA_MANUFACTURER_DATA, mfg_data, sizeof(mfg_data)),
};

static struct bt_le_ext_adv *adv;


uint8_t ble_data_received(uint8_t *data, uint16_t len)
{
	int err;

	for (uint16_t pos = 0; pos != len;) {
		struct uart_data_t *tx = k_malloc(sizeof(*tx));

		if (!tx) {
			// printk("Not able to allocate UART send data buffer");
			return 1;
		}

		/* Keep the last byte of TX buffer for potential LF char. */
		size_t tx_data_size = sizeof(tx->data) - 1;

		if ((len - pos) > tx_data_size) {
			tx->len = tx_data_size;
		} else {
			tx->len = (len - pos);
		}

		memcpy(tx->data, &data[pos], tx->len);

		pos += tx->len;

		/* Append the LF character when the CR character triggered
		 * transmission from the peer.
		 */
		if ((pos == len) && (data[len - 1] == '\r')) {
			tx->data[tx->len] = '\n';
			tx->len++;
		}

		err = uart_tx(uart, tx->data, tx->len, SYS_FOREVER_MS);
		if (err) {
			k_fifo_put(&fifo_uart_tx_data, tx);
		}
	}

	return 1;
}

static void uart_cb(const struct device *dev, struct uart_event *evt, void *user_data)
{
	ARG_UNUSED(dev);

	static size_t aborted_len;
	struct uart_data_t *buf;
	static uint8_t *aborted_buf;
	static bool disable_req;

	switch (evt->type) {
	case UART_TX_DONE:
		// printk("UART_TX_DONE\n");
		if ((evt->data.tx.len == 0) ||
		    (!evt->data.tx.buf)) {
			return;
		}

		if (aborted_buf) {
			buf = CONTAINER_OF(aborted_buf, struct uart_data_t,
					   data);
			aborted_buf = NULL;
			aborted_len = 0;
		} else {
			buf = CONTAINER_OF(evt->data.tx.buf,
					   struct uart_data_t,
					   data);
		}

		k_free(buf);

		buf = k_fifo_get(&fifo_uart_tx_data, K_NO_WAIT);
		if (!buf) {
			return;
		}

		if (uart_tx(uart, buf->data, buf->len, SYS_FOREVER_MS)) {
			// printk("Failed to send data over UART\n");
		}

		break;

	case UART_RX_RDY:
		// printk("UART_RX_RDY\n");
		buf = CONTAINER_OF(evt->data.rx.buf, struct uart_data_t, data);
		buf->len += evt->data.rx.len;

		if (disable_req) {
			return;
		}

		if ((evt->data.rx.buf[buf->len - 1] == '\n') ||
		    (evt->data.rx.buf[buf->len - 1] == '\r')) {
			disable_req = true;
			uart_rx_disable(uart);
		}

		break;

	case UART_RX_DISABLED:
		// printk("UART_RX_DISABLED\n");
		disable_req = false;

		buf = k_malloc(sizeof(*buf));
		if (buf) {
			buf->len = 0;
		} else {
			// printk("Not able to allocate UART receive buffer. size = %d\n", sizeof(*buf));
			k_work_reschedule(&uart_work, UART_WAIT_FOR_BUF_DELAY);
			return;
		}

		uart_rx_enable(uart, buf->data, sizeof(buf->data),
			       UART_RX_TIMEOUT);

		break;

	case UART_RX_BUF_REQUEST:
		// printk("UART_RX_BUF_REQUEST\n");
		buf = k_malloc(sizeof(*buf));
		if (buf) {
			buf->len = 0;
			uart_rx_buf_rsp(uart, buf->data, sizeof(buf->data));
		} else {
			// printk("UART_RX_BUF_REQUEST Not able to allocate UART receive buffer size %d\n", sizeof(*buf));
		}

		break;

	case UART_RX_BUF_RELEASED:
		// printk("UART_RX_BUF_RELEASED\n");
		buf = CONTAINER_OF(evt->data.rx_buf.buf, struct uart_data_t,
				   data);

		if (buf->len > 0) {
			k_fifo_put(&fifo_uart_rx_data, buf);
		} else {
			k_free(buf);
		}

		break;

	case UART_TX_ABORTED:
		// printk("UART_TX_ABORTED\n");
		if (!aborted_buf) {
			aborted_buf = (uint8_t *)evt->data.tx.buf;
		}

		aborted_len += evt->data.tx.len;
		buf = CONTAINER_OF(aborted_buf, struct uart_data_t,
				   data);

		uart_tx(uart, &buf->data[aborted_len],
			buf->len - aborted_len, SYS_FOREVER_MS);

		break;

	default:
		break;
	}
}

static void uart_work_handler(struct k_work *item)
{
	struct uart_data_t *buf;

	buf = k_malloc(sizeof(*buf));
	if (buf) {
		buf->len = 0;
	} else {
		// printk("uart_work_handler: Not able to allocate UART receive buffer\n");
		k_work_reschedule(&uart_work, UART_WAIT_FOR_BUF_DELAY);
		return;
	}

	uart_rx_enable(uart, buf->data, sizeof(buf->data), UART_RX_TIMEOUT);
}

static int uart_init(void)
{
	int err;
	struct uart_data_t *rx;

	if (!device_is_ready(uart)) {
		// printk("uart_init: UART device not ready\n");
		return -ENODEV;
	}

	rx = k_malloc(sizeof(*rx));
	if (rx) {
		rx->len = 0;
	} else {
		return -ENOMEM;
	}

	k_work_init_delayable(&uart_work, uart_work_handler);

	err = uart_callback_set(uart, uart_cb, NULL);
	if (err) {
		return err;
	}

	return uart_rx_enable(uart, rx->data, sizeof(rx->data),
			      UART_RX_TIMEOUT);
}

static void device_found(const bt_addr_le_t *addr, int8_t rssi, uint8_t type,
			 struct net_buf_simple *ad)
{
	char addr_str[BT_ADDR_LE_STR_LEN];
	// char scan_adr = "F2:45:C2:1D:B3:46";

	bt_addr_le_to_str(addr, addr_str, sizeof(addr_str));
}

static void scan_recv(const struct bt_le_scan_recv_info *info,
		      struct net_buf_simple *buf)
{
	char le_addr[BT_ADDR_LE_STR_LEN];
	char name[NAME_LEN];
	uint8_t data_status;
	uint16_t data_len;

	(void)memset(name, 0, sizeof(name));

	data_len = buf->len;
	// bt_data_parse(buf, data_cb, name);

	data_status = BT_HCI_LE_ADV_EVT_TYPE_DATA_STATUS(info->adv_props);

	bt_addr_le_to_str(info->addr, le_addr, sizeof(le_addr));

	if(info->addr->a.val[5] == 242 && info->addr->a.val[4] == 69 && info->addr->a.val[3] == 194 && info->addr->a.val[2] == 29 && info->addr->a.val[1] == 179 && info->addr->a.val[0] == 70){	
		if(buf->data[4] == 1 && buf->data[5] == 2){
			uint8_t data[BLE_ARRAY_MAX];
			for (size_t i = 0; i < RECEIVED_DATA_SIZE; i++) {
				data[i] = buf->data[i+4];
			}
			ble_data_received(data, RECEIVED_DATA_SIZE);
			// printk("scan success");
		}
		
	}
}

static struct bt_le_scan_cb scan_callbacks = {
	.recv = scan_recv,
};

void ble_set_mac(bt_addr_t* addr) {
	struct net_buf *buf;
	int err;

	buf = bt_hci_cmd_create(BT_HCI_OP_VS_WRITE_BD_ADDR, sizeof(*addr));
	if(!buf) {
		// REPORT_ERROR(-ENOBUFS);
	}

	net_buf_add_mem(buf, addr, sizeof(*addr));

	err = bt_hci_cmd_send_sync(BT_HCI_OP_VS_WRITE_BD_ADDR, buf, NULL);
	if(err) {
		// REPORT_ERROR(err);
	}
}

int broadcaster_multiple(void)
{
	struct bt_le_scan_param scan_param = {
		.type       = BT_LE_SCAN_TYPE_PASSIVE,
		.options    = BT_LE_SCAN_OPT_FILTER_DUPLICATE,
		.interval   = 0x0030, //BT_GAP_SCAN_FAST_INTERVAL,
		.window     = 0x0030, //BT_GAP_SCAN_FAST_WINDOW,
		.timeout 	= 0x0000, //BT_GAP_PER_ADV_MAX_TIMEOUT, 								// How long the scanner will run before stopping automatically.
	};
	struct bt_le_adv_param adv_param = {
		.id = BT_ID_DEFAULT,
		.sid = 0U, /* Supply unique SID when creating advertising set */
		.secondary_max_skip = 0U,
		.options = (BT_LE_ADV_OPT_EXT_ADV | BT_LE_ADV_OPT_USE_IDENTITY | BT_LE_ADV_OPT_USE_NAME | BT_LE_ADV_OPT_USE_TX_POWER | BT_LE_ADV_OPT_NO_2M),
		.interval_min = 0x0020, //BT_GAP_ADV_FAST_INT_MIN_1, //BT_GAP_ADV_FAST_INT_MIN_2,
		.interval_max = 0x0030, //BT_GAP_ADV_FAST_INT_MAX_1, //BT_GAP_ADV_FAST_INT_MAX_2,
		.peer = NULL,
	};
	int err;

	/* Initialize the Bluetooth Subsystem */
	err = bt_enable(NULL);
	if (err) {
		printk("Bluetooth init failed (err %d)\n", err);
		return err;
	}

/* CONFIG_BT_EXT_ADV */
	// bt_le_scan_cb_register(&scan_callbacks);
	// printk("Registered scan callbacks\n");
/* CONFIG_BT_EXT_ADV */

	ble_set_mac(&mac);
	if (IS_ENABLED(CONFIG_SETTINGS)) {
		err = settings_load();
		printk("Settings loaded (info %d)\n", err);
	}

	/* Create a non-connectable non-scannable advertising set */
	err = bt_le_ext_adv_create(&adv_param, NULL, &adv);
	if (err) {
		printk("Failed to create advertising set (err %d)\n", err);
		return err;
	}
	// printk("Created advertising set.\n");
	bc_ref_pos_lattitude.bit_32 = 0;
	bc_ref_pos_longitude.bit_32 = 0;

	for (;;) {
//_________________________________________________(Tx)_________________________________________________________________

		bc_ref_pos_lattitude.bit_32 += 1;

		if(bc_ref_pos_lattitude.bit_32 > 600){ 	// 1 min delay
			bc_ref_pos_longitude.bit_32 += 1;
		} else {
			bc_ref_pos_longitude.bit_32 = 0;
		}
		mfg_data[9] = bc_ref_pos_lattitude.bit_8[3];
		mfg_data[10] = bc_ref_pos_lattitude.bit_8[2];
		mfg_data[11] = bc_ref_pos_lattitude.bit_8[1];
		mfg_data[12] = bc_ref_pos_lattitude.bit_8[0];

		mfg_data[13] = bc_ref_pos_longitude.bit_8[3];
		mfg_data[14] = bc_ref_pos_longitude.bit_8[2];
		mfg_data[15] = bc_ref_pos_longitude.bit_8[1];
		mfg_data[16] = bc_ref_pos_longitude.bit_8[0];

		err = bt_le_ext_adv_set_data(adv, ad, ARRAY_SIZE(ad), NULL, 0);
		if (err) {
			printk("Failed to set advertising data for set (err %d)\n", err);
		}

		err = bt_le_ext_adv_start(adv, BT_LE_EXT_ADV_START_DEFAULT);
		if (err) {
			printk("Failed to start extended advertising set (err %d)\n", err);
		}
		
		k_sleep(K_MSEC(90)); 	// stable 100 ms

		bt_le_ext_adv_stop(adv);
		if (err) {
			printk("Advertising failed to stop (err %d)\n", err);
		}

	}

	return 0;
}
```

## src/cam.h
```c
#include <stddef.h>

/* UART payload buffer element size. */
#define BLE_ARRAY_MAX 227
#define UART_BUF_SIZE 600 //cannot use 2 powers for some reason
#define CAM_DATA_SIZE 65 		// the information which is valueable and which can be used
#define UART_DATA_SIZE 71

#define NAME_LEN 30

#define STATE_IDLE 0
#define STATE_SCAN 1
#define STATE_BROADCAST 2

uint8_t 	pdu_proto_version 				= 4;
uint8_t  	pdu_message_id 					= 2;
union 	pdu_src_station_id_t{
	uint32_t bit_32;
	uint8_t bit_8[4];
} pdu_src_station_id 						= { .bit_32 = 100 };

uint8_t 	bc_station_type 					= 0;
union bc_ref_pos_lattitude_t{
	uint32_t bit_32;
	uint8_t bit_8[4];
} bc_ref_pos_lattitude 							= { .bit_32 = 0xaabbccdd };
union bc_ref_pos_longitude_t{
 uint32_t bit_32;
 uint8_t bit_8[4];
} bc_ref_pos_longitude 							= { .bit_32 = 599 };
union bc_ref_pos_conf_ellipse_semi_major_t{
 uint16_t bit_16;
 uint8_t bit_8[2];
} bc_ref_pos_conf_ellipse_semi_major 			= { .bit_16 = 599 };
union bc_ref_pos_conf_ellipse_semi_minor_t{
 uint16_t bit_16;
 uint8_t bit_8[2];
} bc_ref_pos_conf_ellipse_semi_minor 			= { .bit_16 = 0 };
union bc_ref_pos_altitude_heading_t{
 uint16_t bit_16;
 uint8_t bit_8[2];
} bc_ref_pos_altitude_heading 					= { .bit_16 = 0 };
union bc_ref_pos_altitude_val_t{
 uint32_t bit_32;
 uint8_t bit_8[4];
} bc_ref_pos_altitude_val 						= { .bit_32 = 1999 };
uint8_t bc_ref_pos_altitude_conf 				= 0;

union hf_heading_val_t{
 uint32_t bit_16;
 uint8_t bit_8[2];
} hf_heading_val 								= { .bit_16 = 1999 };
uint8_t hf_heading_conf 						= 0;
union hf_vertical_heading_t{
 uint16_t bit_16;
 uint8_t bit_8[2];
} hf_vertical_heading 					        = { .bit_16 = 0 };
union hf_speed_val_t{
 uint16_t bit_16;
 uint8_t bit_8[2];
} hf_speed_val 					                = { .bit_16 = 0 };
uint8_t hf_speed_conf 						    = 0;
union hf_drive_dir_heading_val_t{
 uint16_t bit_16;
 uint8_t bit_8[2];
} hf_drive_dir_heading_val 					    = { .bit_16 = 0 };
uint8_t hf_drive_dir_heading_conf 				= 0;
union hf_drive_dir_vertical_heading_t{
 uint16_t bit_16;
 uint8_t bit_8[2];
} hf_drive_dir_vertical_heading 				= { .bit_16 = 0 };
union hf_v_len_val_t{
 uint16_t bit_16;
 uint8_t bit_8[2];
} hf_v_len_val 					                = { .bit_16 = 0 };
uint8_t hf_v_len_conf 						    = 0;
union hf_v_width_t{
 uint16_t bit_16;
 uint8_t bit_8[2];
} hf_v_width 					                = { .bit_16 = 0 };
union hf_v_height_t{
 uint16_t bit_16;
 uint8_t bit_8[2];
} hf_v_height 					                = { .bit_16 = 0 };
union hf_long_acc_val_t{
 uint16_t bit_16;
 uint8_t bit_8[2];
} hf_long_acc_val 					            = { .bit_16 = 0 };
uint8_t hf_long_acc_conf 						= 0;
union hf_curv_val_t{
 uint16_t bit_16;
 uint8_t bit_8[2];
} hf_curv_val 					                = { .bit_16 = 0 };
uint8_t hf_curv_conf 						    = 0;
uint8_t hf_curv_cal_mod 						= 0;
union hf_yaw_r_val_t{
 uint16_t bit_16;
 uint8_t bit_8[2];
} hf_yaw_r_val 					                = { .bit_16 = 0 };
uint8_t hf_yaw_r_conf 						    = 0;
union hf_lat_acc_val_t{
 uint16_t bit_16;
 uint8_t bit_8[2];
} hf_lat_acc_val 					            = { .bit_16 = 0 };
uint8_t hf_lat_acc_conf 						= 0;
union hf_vertical_acc_val_t{
 uint16_t bit_16;
 uint8_t bit_8[2];
} hf_vertical_acc_val 					        = { .bit_16 = 0 };
uint8_t hf_vertical_acc_conf 					= 0;

union uav_safetyarearadius_t{
 uint16_t bit_16;
 uint8_t bit_8[2];
} uav_safetyarearadius 					        = { .bit_16 = 0 };
uint8_t uav_pathhistory_len 					= 0;

uint8_t mfg_data[BLE_ARRAY_MAX + 2] = { 0x00, 0x00, 0x00, 0x00, 0x00, 0x00, 0x00, 0x00, 0x00, 0x00, 	// 1
						0x00, 0x00, 0x00, 0x00, 0x00, 0x00, 0x00, 0x00, 0x00, 0x00, 	// 2
						0x00, 0x00, 0x00, 0x00, 0x00, 0x00, 0x00, 0x00, 0x00, 0x00, 	// 3
						0x00, 0x00, 0x00, 0x00, 0x00, 0x00, 0x00, 0x00, 0x00, 0x00, 	// 4
						0x00, 0x00, 0x00, 0x00, 0x00, 0x00, 0x00, 0x00, 0x00, 0x00, 	// 5
						0x00, 0x00, 0x00, 0x00, 0x00, 0x00, 0x00, 0x00, 0x00, 0x00, 	// 6
						0x00, 0x00, 0x00, 0x00, 0x00, 0x00, 0x00, 0x00, 0x00, 0x00, 	// 7
						0x00, 0x00, 0x00, 0x00, 0x00, 0x00, 0x00, 0x00, 0x00, 0x00, 	// 8
						0x00, 0x00, 0x00, 0x00, 0x00, 0x00, 0x00, 0x00, 0x00, 0x00, 	// 9
						0x00, 0x00, 0x00, 0x00, 0x00, 0x00, 0x00, 0x00, 0x00, 0x00, 	// 10
						0x00, 0x00, 0x00, 0x00, 0x00, 0x00, 0x00, 0x00, 0x00, 0x00, 	// 11
						0x00, 0x00, 0x00, 0x00, 0x00, 0x00, 0x00, 0x00, 0x00, 0x00, 	// 12
						0x00, 0x00, 0x00, 0x00, 0x00, 0x00, 0x00, 0x00, 0x00, 0x00, 	// 13
						0x00, 0x00, 0x00, 0x00, 0x00, 0x00, 0x00, 0x00, 0x00, 0x00, 	// 14
						0x00, 0x00, 0x00, 0x00, 0x00, 0x00, 0x00, 0x00, 0x00, 0x00, 	// 15
						0x00, 0x00, 0x00, 0x00, 0x00, 0x00, 0x00, 0x00, 0x00, 0x00, 	// 16
						0x00, 0x00, 0x00, 0x00, 0x00, 0x00, 0x00, 0x00, 0x00, 0x00, 	// 17
						0x00, 0x00, 0x00, 0x00, 0x00, 0x00, 0x00, 0x00, 0x00, 0x00, 	// 18
						0x00, 0x00, 0x00, 0x00, 0x00, 0x00, 0x00, 0x00, 0x00, 0x00, 	// 19
						0x00, 0x00, 0x00, 0x00, 0x00, 0x00, 0x00, 0x00, 0x00, 0x00, 	// 20
						0x00, 0x00, 0x00, 0x00, 0x00, 0x00, 0x00, 0x00, 0x00, 0x00, 	// 21
						0x00, 0x00, 0x00, 0x00, 0x00, 0x00, 0x00, 0x00, 0x00, 0x00, 	// 22
						0x00, 0x00, 0x00, 0x00, 0x00, 0x00, 0x00, 0x00, 0x00/*, 0x00, 	// 23
						0x00, 0x00, 0x00, 0x00, 0x00, 0x00, 0x00, 0x00, 0x00, 0x00, 	// 24
						0x00, 0x00, 0x00, 0x00, 0x00, 0x00, 0x00, 0x00, 0x00, 0x00, 	// 25
						0x00, 0x00, 0x00, 0x00, 0x00, 0x00, 0x00, 0x00, 0x00, 0x00 		// 26
						*/};
```
